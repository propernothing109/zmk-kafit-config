## config/boards/shields/kafit/Kconfig.shield
```kconfig
config SHIELD_KAFIT_LEFT
    def_bool $(shields_list_contains,kafit_left)

config SHIELD_KAFIT_RIGHT
    def_bool $(shields_list_contains,kafit_right)
```
